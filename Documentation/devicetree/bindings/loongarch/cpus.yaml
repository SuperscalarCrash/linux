## Documentation/devicetree/bindings/loongarch/cpus.yaml
```yaml
# SPDX-License-Identifier: (GPL-2.0-only OR BSD-2-Clause)
%YAML 1.2
---
$id: http://devicetree.org/schemas/loongarch/cpus.yaml#
$schema: http://devicetree.org/meta-schemas/core.yaml#

title: LoongArch CPUs

maintainers:
  - Binbin Zhou <zhoubinbin@loongson.cn>

description:
  This document describes the list of LoongArch CPU cores that support FDT,
  it describe the layout of CPUs in a system through the "cpus" node.

allOf:
  - $ref: /schemas/cpu.yaml#

properties:
  compatible:
    enum:
      - loongson,la32r
      - loongson,la264
      - loongson,la364

  reg:
    maxItems: 1

  clocks:
    maxItems: 1

required:
  - compatible
  - reg

if:
  properties:
    compatible:
      const: loongson,la32r
then:
  description:
    Strict LA32R implementations do not have CPUCFG.  A boot environment may
    supply the CPU and constant-timer rate with the cpuclock= kernel parameter
    when neither clocks nor clock-frequency is present.
else:
  anyOf:
    - required:
        - clocks
    - required:
        - clock-frequency

unevaluatedProperties: false

examples:
  - |
    #include <dt-bindings/clock/loongson,ls2k-clk.h>

    cpus {
        #size-cells = <0>;
        #address-cells = <1>;

        cpu@0 {
            compatible = "loongson,la264";
            device_type = "cpu";
            reg = <0>;
            clocks = <&clk LOONGSON2_NODE_CLK>;
        };

        cpu@1 {
            compatible = "loongson,la264";
            device_type = "cpu";
            reg = <1>;
            clocks = <&clk LOONGSON2_NODE_CLK>;
        };
    };

...
```

## Documentation/devicetree/bindings/net/loongson,chiplab-dmfe.yaml
```yaml
# SPDX-License-Identifier: (GPL-2.0-only OR BSD-2-Clause)
%YAML 1.2
---
$id: http://devicetree.org/schemas/net/loongson,chiplab-dmfe.yaml#
$schema: http://devicetree.org/meta-schemas/core.yaml#

title: Loongson Chiplab DMFE-compatible Ethernet controller

maintainers:
  - eWloYW8 <3171132517@qq.com>

description:
  The Chiplab FPGA design contains a platform-attached 10/100 Mbit Ethernet
  MAC derived from the Davicom DM9102 programming model.

properties:
  compatible:
    const: loongson,chiplab-dmfe

  reg:
    maxItems: 1

  interrupts:
    maxItems: 1

  local-mac-address: true

  phy-mode:
    const: rgmii

required:
  - compatible
  - reg
  - interrupts

allOf:
  - $ref: ethernet-controller.yaml#

unevaluatedProperties: false

examples:
  - |
    ethernet@1ff00000 {
        compatible = "loongson,chiplab-dmfe";
        reg = <0x1ff00000 0x10000>;
        interrupts = <2>;
        local-mac-address = [00 98 76 64 32 19];
        phy-mode = "rgmii";
    };
```

## Documentation/devicetree/bindings/soc/loongson/loongson,chiplab-confreg.yaml
```yaml
# SPDX-License-Identifier: (GPL-2.0-only OR BSD-2-Clause)
%YAML 1.2
---
$id: http://devicetree.org/schemas/soc/loongson/loongson,chiplab-confreg.yaml#
$schema: http://devicetree.org/meta-schemas/core.yaml#

title: Loongson Chiplab CONFREG board peripherals

description: |
  The CONFREG block in the Loongson Chiplab FPGA system contains simple
  memory-mapped board peripherals.  This binding covers its 16 monochrome
  LEDs, two red/green LEDs, eight-digit hexadecimal seven-segment display,
  and eight slide switches.

maintainers:
  - inuEbisu <inuebisu@outlook.com>

properties:
  compatible:
    const: loongson,chiplab-confreg

  reg:
    maxItems: 1

  gpio-controller: true

  '#gpio-cells':
    const: 2

  gpio-line-names:
    minItems: 8
    maxItems: 8

required:
  - compatible
  - reg
  - gpio-controller
  - '#gpio-cells'

additionalProperties: false

examples:
  - |
    confreg@1fd0f000 {
        compatible = "loongson,chiplab-confreg";
        reg = <0x1fd0f000 0x24>;
        gpio-controller;
        #gpio-cells = <2>;
        gpio-line-names = "switch0", "switch1", "switch2", "switch3",
                          "switch4", "switch5", "switch6", "switch7";
    };
```

## Documentation/devicetree/bindings/usb/superscalarcrash,chiplab-ue11.yaml
```yaml
# SPDX-License-Identifier: (GPL-2.0-only OR BSD-2-Clause)
%YAML 1.2
---
$id: http://devicetree.org/schemas/usb/superscalarcrash,chiplab-ue11.yaml#
$schema: http://devicetree.org/meta-schemas/core.yaml#

title: SuperscalarCrash Chiplab UE11 USB host controller

maintainers:
  - SuperscalarCrash Team <superscalarcrash@users.noreply.github.com>

description: |
  A one-port, PIO-only USB 1.1 Full-Speed host controller connected to the
  USB3500 UTMI+ PHY on the NSCSCC Chiplab board.  This integration uses a
  board-specific UE11 register map and exposes a read-only ABI identifier.

allOf:
  - $ref: usb-hcd.yaml#

properties:
  compatible:
    const: superscalarcrash,chiplab-ue11

  reg:
    maxItems: 1

  interrupts:
    maxItems: 1

  dr_mode:
    const: host

  maximum-speed:
    const: full-speed

required:
  - compatible
  - reg
  - interrupts

unevaluatedProperties: false

examples:
  - |
    usb@1d040000 {
        compatible = "superscalarcrash,chiplab-ue11";
        reg = <0x1d040000 0x1000>;
        interrupts = <8>;
        dr_mode = "host";
        maximum-speed = "full-speed";
    };

...
```

## arch/loongarch/configs/chiplab_la32r_defconfig
```kconfig
CONFIG_LOCALVERSION="-chiplab-la32r"
# CONFIG_LOCALVERSION_AUTO is not set
CONFIG_SYSVIPC=y
CONFIG_POSIX_MQUEUE=y
CONFIG_LOG_BUF_SHIFT=16
CONFIG_BLK_DEV_INITRD=y
CONFIG_CC_OPTIMIZE_FOR_SIZE=y
CONFIG_EXPERT=y
CONFIG_32BIT=y
CONFIG_HZ_100=y
CONFIG_4KB_2LEVEL=y
CONFIG_CMDLINE="console=tty0 console=ttyS0,115200 earlycon=uart8250,mmio,0x1fe001e0,115200 cpuclock=100000000 root=/dev/nfs rw nfsroot=172.25.2.193:/srv/gemmont-rootfs-v031-ablation,vers=3,tcp ip=172.25.2.56:172.25.2.193:172.25.2.254:255.255.255.0:gemmont:eth0:off"
CONFIG_CMDLINE_FORCE=y
CONFIG_ARCH_IOREMAP=y
CONFIG_BUILTIN_DTB=y
CONFIG_BUILTIN_DTB_NAME="loongson-chiplab"
# CONFIG_DMI is not set
# CONFIG_EFI_STUB is not set
CONFIG_NET=y
CONFIG_PACKET=y
CONFIG_UNIX=y
CONFIG_INET=y
CONFIG_IP_PNP=y
CONFIG_IP_PNP_DHCP=y
CONFIG_NETWORK_FILESYSTEMS=y
CONFIG_NFS_FS=y
# CONFIG_NFS_V2 is not set
CONFIG_NFS_V3=y
CONFIG_ROOT_NFS=y
CONFIG_DEVTMPFS=y
CONFIG_DEVTMPFS_MOUNT=y
CONFIG_CMA=y
CONFIG_DMA_CMA=y
CONFIG_CMA_SIZE_MBYTES=4
CONFIG_MODULES=y
CONFIG_MTD=y
CONFIG_MTD_OF_PARTS=y
CONFIG_MTD_RAW_NAND=y
CONFIG_MTD_NAND_LOONGSON=y
CONFIG_MTD_UBI=y
CONFIG_MTD_UBI_BLOCK=y
CONFIG_UBIFS_FS=y
# CONFIG_INPUT_KEYBOARD is not set
# CONFIG_INPUT_MOUSE is not set
# CONFIG_SERIO_I8042 is not set
CONFIG_GPIOLIB=y
CONFIG_GPIO_CDEV=y
CONFIG_DMADEVICES=y
CONFIG_LOONGSON1_APB_DMA=y
CONFIG_NETDEVICES=y
CONFIG_CHIPLAB_DMFE=y
CONFIG_SERIAL_8250=y
CONFIG_SERIAL_8250_CONSOLE=y
CONFIG_SERIAL_OF_PLATFORM=y
CONFIG_FB=y
CONFIG_FB_DEVICE=y
CONFIG_FB_XILINX=y
CONFIG_FRAMEBUFFER_CONSOLE=y
CONFIG_VT=y
CONFIG_VT_CONSOLE=y
CONFIG_LOGO=y
CONFIG_LOGO_LINUX_CLUT224=y
CONFIG_NEW_LEDS=y
CONFIG_LEDS_CLASS=y
CONFIG_CHIPLAB_CONFREG=y
CONFIG_TMPFS=y
CONFIG_PRINTK_TIME=y
```

## drivers/platform/loongarch/Kconfig
```kconfig
#
# LoongArch Platform Specific Drivers
#

menuconfig LOONGARCH_PLATFORM_DEVICES
	bool "LoongArch Platform Specific Device Drivers"
	default y
	depends on LOONGARCH
	help
	  Say Y here to get to see options for device drivers of various
	  LoongArch platforms, including vendor-specific laptop/desktop
	  extension and hardware monitor drivers. This option itself does
	  not add any kernel code.

	  If you say N, all options in this submenu will be skipped and disabled.

if LOONGARCH_PLATFORM_DEVICES

config LOONGSON_LAPTOP
	tristate "Generic Loongson-3 Laptop Driver"
	depends on ACPI_EC
	depends on BACKLIGHT_CLASS_DEVICE
	depends on INPUT
	depends on MACH_LOONGSON64
	select ACPI_VIDEO
	select INPUT_SPARSEKMAP
	default y
	help
	  ACPI-based Loongson-3 family laptops generic driver.

config CHIPLAB_CONFREG
	tristate "Loongson Chiplab CONFREG peripherals"
	depends on OF && MACH_LOONGSON32
	depends on GPIOLIB
	depends on LEDS_CLASS
	help
	  Support the board control registers in the Loongson Chiplab FPGA
	  system.  The driver exposes the 16 monochrome LEDs and the red and
	  green channels of both bicolor LEDs through the LED class, and the
	  eight slide switches as an input-only GPIO controller.  It also
	  provides sysfs attributes for whole-register LED control, the
	  eight-digit hexadecimal seven-segment display, and switch sampling.

endif # LOONGARCH_PLATFORM_DEVICES
```
